## controller/sdkconfig.defaults
```kconfig
#
# WiFi IRAM optimization - move WiFi functions to flash to save IRAM
#
CONFIG_ESP32_WIFI_IRAM_OPT=n
CONFIG_ESP32_WIFI_RX_IRAM_OPT=n
CONFIG_LWIP_IRAM_OPTIMIZATION=n
CONFIG_LWIP_TCP_ISR_IRAM_OPTIMIZATION=n
```
